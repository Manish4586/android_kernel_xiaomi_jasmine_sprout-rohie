&red_led {
	qcom,start-idx = <1>;
	qcom,duty-pcts =
		[00 01 04 0a 11 19 23 2d
		37 41 4b 53 5a 60 63 64];
	qcom,idx-len = <16>;
	qcom,pause-lo = <1200>;
	qcom,pause-hi = <600>;
	qcom,ramp-step-ms = <62>;
	qcom,lut-flags = <31>;
	qcom,use-blink;
};
